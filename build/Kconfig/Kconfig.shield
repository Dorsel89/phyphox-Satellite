## build/Kconfig/Kconfig.shield
```kconfig
osource "c:/Users/Dominik/Documents/GitHub/phyphox-Satellite/boards/shields/*/Kconfig.shield"
osource "C:/Users/Dominik/Documents/GitHub/phyphox-Satellite/boards/shields/*/Kconfig.shield"
osource "C:/Users/Dominik/ncs/v2.0.0/nrf/boards/shields/*/Kconfig.shield"
```

## build/Kconfig/Kconfig.shield.defconfig
```kconfig
osource "f:/Code/sat/phyphox-Satellite/boards/shields/*/Kconfig.defconfig"
osource "F:/Code/sat/phyphox-Satellite/boards/shields/*/Kconfig.defconfig"
osource "C:/Users/edwar/ncs/v2.0.0/nrf/boards/shields/*/Kconfig.defconfig"
```

## build_1/Kconfig/Kconfig.shield
```kconfig
osource "f:/Code/phyphox-Satellite-main/phyphox-Satellite-main/boards/shields/*/Kconfig.shield"
osource "F:/Code/phyphox-Satellite-main/phyphox-Satellite-main/boards/shields/*/Kconfig.shield"
osource "C:/Users/edwar/ncs/v1.9.1/nrf/boards/shields/*/Kconfig.shield"
```

## build_1/Kconfig/Kconfig.shield.defconfig
```kconfig
osource "f:/Code/phyphox-Satellite-main/phyphox-Satellite-main/boards/shields/*/Kconfig.defconfig"
osource "F:/Code/phyphox-Satellite-main/phyphox-Satellite-main/boards/shields/*/Kconfig.defconfig"
osource "C:/Users/edwar/ncs/v1.9.1/nrf/boards/shields/*/Kconfig.defconfig"
```
